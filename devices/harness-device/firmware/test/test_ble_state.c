// B4a: the BLE link's state machine, its deadlines and its accept policy (ble_state.c). Pure logic: no IDF, no clock, no RNG.
//
//   cc -std=c11 -Wall -Wextra -Werror -O1 -g -fsanitize=undefined,bounds -I ../main test_ble_state.c ../main/ble_state.c ../main/net_state.c
//   ./a.out vectors/ble_status.txt
//
// The numbers are read from the shared vector file (generated by scripts/gen_ble_vectors.py) and compared with the module's constants, so a deadline
// cannot move on the dial alone.
#include <assert.h>
#include <stdint.h>
#include <stdio.h>
#include <stdlib.h>
#include <string.h>

#include "ble_state.h"
#include "net_state.h"

static unsigned checks;
#define CHECK(x) do { assert(x); checks++; } while (0)

// ── the table, written out a second time from the spec (cable-ble-link.md and the plan's B4a) ───────────────────
// Letters: O off, A advertising, F not found, S securing, C connected, H channel up (handshake), U tls up, R auth failed (key refused).
// Event order: START STOP ADV_TIMEOUT LINK_UP LINK_DOWN ENCRYPTED ENC_TIMEOUT CHANNEL_OPEN CHANNEL_CLOSED TLS_UP TLS_FAIL TLS_REFUSED IDLE_TIMEOUT
// (B4e: a link that arrives just as the advertising timer fires is still a link: NOT_FOUND takes LINK_UP; and a peer that is not authenticated-bonded
// is dropped after BLE_IDLE_CAP_MS in CONNECTED: IDLE_TIMEOUT)
static const char *const EXPECT[BLE_ST_COUNT] = {
    /* OFF  */ "AOOOOOOOOOOOO",
    /* ADV  */ "AOFSAAAAAAAAA",
    /* NOTF */ "AOFSFFFFFFFFF",
    /* SEC  */ "SOSSACASSSSSS",
    /* CONN */ "COCCACCHCCCCA",
    /* CHAN */ "HOHHAHHHCUCRH",
    /* TLS  */ "UOUUAUUUCUCUU",
    /* AUTH */ "RORRARRRRRRRR",
};

static ble_state_t letter(char c)
{
    switch (c) {
    case 'O': return BLE_ST_OFF;
    case 'A': return BLE_ST_ADVERTISING;
    case 'F': return BLE_ST_NOT_FOUND;
    case 'S': return BLE_ST_SECURING;
    case 'C': return BLE_ST_CONNECTED;
    case 'H': return BLE_ST_CHANNEL_UP;
    case 'U': return BLE_ST_TLS_UP;
    case 'R': return BLE_ST_AUTH_FAILED;
    }
    assert(!"bad letter");
    return BLE_ST_OFF;
}

static void test_table(void)
{
    CHECK(BLE_ST_COUNT == 8 && BLE_EV_COUNT == 13);
    for (int s = 0; s < BLE_ST_COUNT; s++) {
        CHECK(strlen(EXPECT[s]) == BLE_EV_COUNT);
        for (int e = 0; e < BLE_EV_COUNT; e++) {
            const ble_state_t got = ble_state_next((ble_state_t)s, (ble_event_t)e);
            if (got != letter(EXPECT[s][e])) {
                printf("table: state %s event %d: got %s, expected %c\n", ble_state_name((ble_state_t)s), e, ble_state_name(got), EXPECT[s][e]);
                assert(0);
            }
            checks++;
        }
    }
    // Out of range: the state is held, and a state out of range reads as OFF; nothing reads outside the table.
    CHECK(ble_state_next((ble_state_t)99, BLE_EV_START) == BLE_ST_OFF);
    CHECK(ble_state_next(BLE_ST_TLS_UP, (ble_event_t)99) == BLE_ST_TLS_UP);
    CHECK(ble_state_next(BLE_ST_SECURING, (ble_event_t)-1) == BLE_ST_SECURING);
    // STOP is OFF from everywhere, and OFF takes nothing but START.
    for (int s = 0; s < BLE_ST_COUNT; s++) CHECK(ble_state_next((ble_state_t)s, BLE_EV_STOP) == BLE_ST_OFF);
    for (int e = 1; e < BLE_EV_COUNT; e++) CHECK(ble_state_next(BLE_ST_OFF, (ble_event_t)e) == BLE_ST_OFF);
    // A lost ACL link is advertising again from every connected state.
    for (int s = BLE_ST_SECURING; s <= BLE_ST_AUTH_FAILED; s++) CHECK(ble_state_next((ble_state_t)s, BLE_EV_LINK_DOWN) == BLE_ST_ADVERTISING);
    // Names are distinct and non-empty.
    for (int a = 0; a < BLE_ST_COUNT; a++) {
        CHECK(ble_state_name((ble_state_t)a)[0] != 0 && strcmp(ble_state_name((ble_state_t)a), "?") != 0);
        for (int b = a + 1; b < BLE_ST_COUNT; b++) CHECK(strcmp(ble_state_name((ble_state_t)a), ble_state_name((ble_state_t)b)) != 0);
    }
    CHECK(strcmp(ble_state_name((ble_state_t)99), "?") == 0);
}

// ── the numbers come from the vector file ───────────────────────────────────────────────────────────
static unsigned long vector_const(const char *path, const char *name)
{
    FILE *f = fopen(path, "r");
    assert(f);
    char line[256];
    unsigned long v = 0;
    int found = 0;
    const size_t n = strlen(name);
    while (fgets(line, sizeof line, f)) {
        if (strncmp(line, "const\t", 6) == 0 && strncmp(line + 6, name, n) == 0 && line[6 + n] == '\t') {
            v = strtoul(line + 7 + n, NULL, 10);
            found++;
        }
    }
    fclose(f);
    assert(found == 1);
    return v;
}

static void test_constants_match_the_vectors(const char *path)
{
    CHECK(BLE_ADV_TIMEOUT_MS == vector_const(path, "adv_timeout_ms"));
    CHECK(BLE_ENC_DEADLINE_MS == vector_const(path, "enc_deadline_ms"));
    CHECK(BLE_TLS_DEADLINE_MS == vector_const(path, "dial_tls_deadline_ms"));
    CHECK(BLE_RETRY_MS == vector_const(path, "adv_retry_ms"));
    CHECK(BLE_KEY_SIZE_MIN == vector_const(path, "key_size_min") && BLE_CHURN_LIMIT == vector_const(path, "churn_limit"));
    CHECK(BLE_COOLDOWN_MS == vector_const(path, "cooldown_ms") && BLE_IDLE_CAP_MS == vector_const(path, "idle_cap_ms"));
    CHECK(BLE_PAIR_WINDOW_MS == vector_const(path, "pair_window_ms"));
    CHECK(BLE_KEY_SIZE_MIN == 16 && BLE_CHURN_LIMIT == 3 && BLE_COOLDOWN_MS == 10000 && BLE_IDLE_CAP_MS == 10000 && BLE_PAIR_WINDOW_MS == 120000);
    CHECK(BLE_ADV_TIMEOUT_MS == 30000 && BLE_ENC_DEADLINE_MS == 3000 && BLE_TLS_DEADLINE_MS == 5000 && BLE_RETRY_MS == 120000);
}

// ── the deadlines ───────────────────────────────────────────────────────────────────────────────────
static void test_deadlines(void)
{
    ble_t b;
    // 2.9 s is not 3.0 s: a link not encrypted by the deadline is dropped, one tick earlier it is not
    ble_init(&b);
    CHECK(b.state == BLE_ST_OFF && ble_poll(&b, 1000000) == BLE_EV_NONE);   // OFF has no deadline
    CHECK(ble_post(&b, BLE_EV_START, 1000));
    CHECK(b.state == BLE_ST_ADVERTISING && b.since_ms == 1000);
    CHECK(ble_poll(&b, 1000 + 29999) == BLE_EV_NONE);
    CHECK(ble_poll(&b, 1000 + 30000) == BLE_EV_ADV_TIMEOUT);
    CHECK(ble_poll(&b, 1000 + 99999) == BLE_EV_ADV_TIMEOUT);                // still due until somebody acts on it
    CHECK(ble_post(&b, BLE_EV_ADV_TIMEOUT, 31000) && b.state == BLE_ST_NOT_FOUND);
    CHECK(ble_poll(&b, 31000 + BLE_RETRY_MS - 1) == BLE_EV_NONE);            // "Phone not found" waits the retry period ...
    CHECK(ble_poll(&b, 31000 + BLE_RETRY_MS) == BLE_EV_START);              // ... and then asks to advertise again (a START)
    CHECK(ble_poll(&b, 31000 + 10 * BLE_RETRY_MS) == BLE_EV_START);         // still due until somebody acts on it
    CHECK(ble_post(&b, BLE_EV_START, 40000) && b.state == BLE_ST_ADVERTISING && b.since_ms == 40000);

    CHECK(ble_post(&b, BLE_EV_LINK_UP, 50000) && b.state == BLE_ST_SECURING && b.since_ms == 50000);
    CHECK(ble_poll(&b, 50000 + 2900) == BLE_EV_NONE);
    CHECK(ble_poll(&b, 50000 + 2999) == BLE_EV_NONE);
    CHECK(ble_poll(&b, 50000 + 3000) == BLE_EV_ENC_TIMEOUT);
    CHECK(ble_post(&b, BLE_EV_ENC_TIMEOUT, 53000) && b.state == BLE_ST_ADVERTISING && b.since_ms == 53000);   // dropped, advertising again

    // encrypted in time: the deadline is gone
    CHECK(ble_post(&b, BLE_EV_LINK_UP, 60000) && b.state == BLE_ST_SECURING);
    ble_set_trusted(&b, true);                                               // an authenticated, bonded peer (B4e: any other is dropped after BLE_IDLE_CAP_MS)
    CHECK(ble_post(&b, BLE_EV_ENCRYPTED, 60500) && b.state == BLE_ST_CONNECTED);
    CHECK(ble_poll(&b, 60500 + 3600000) == BLE_EV_NONE);                     // waiting for the phone to open the channel: no deadline of ours

    // the channel opens: the handshake deadline starts then, and 4.999 s is not 5 s
    CHECK(ble_post(&b, BLE_EV_CHANNEL_OPEN, 70000) && b.state == BLE_ST_CHANNEL_UP && b.since_ms == 70000);
    CHECK(ble_poll(&b, 70000 + 4999) == BLE_EV_NONE);
    CHECK(ble_poll(&b, 70000 + 5000) == BLE_EV_TLS_FAIL);
    CHECK(ble_post(&b, BLE_EV_TLS_UP, 70400) && b.state == BLE_ST_TLS_UP);
    CHECK(ble_poll(&b, 70400 + 3600000) == BLE_EV_NONE);                     // an established link has no deadline here (keepalive is the cable layer's)

    // a clock that steps back neither fires nor wraps
    ble_init(&b);
    ble_post(&b, BLE_EV_START, 100000);
    CHECK(ble_poll(&b, 50000) == BLE_EV_NONE);
    CHECK(ble_poll(&b, 0) == BLE_EV_NONE);
    // the deadline helper itself
    CHECK(ble_deadline_ms(BLE_ST_ADVERTISING) == BLE_ADV_TIMEOUT_MS && ble_deadline_ms(BLE_ST_SECURING) == BLE_ENC_DEADLINE_MS);
    CHECK(ble_deadline_ms(BLE_ST_CHANNEL_UP) == BLE_TLS_DEADLINE_MS);
    CHECK(ble_deadline_ms(BLE_ST_OFF) == 0 && ble_deadline_ms(BLE_ST_CONNECTED) == 0);
    CHECK(ble_deadline_ms(BLE_ST_NOT_FOUND) == BLE_RETRY_MS);
    CHECK(ble_deadline_ms(BLE_ST_TLS_UP) == 0 && ble_deadline_ms(BLE_ST_AUTH_FAILED) == 0 && ble_deadline_ms((ble_state_t)77) == 0);
    // NULL
    CHECK(ble_poll(NULL, 1) == BLE_EV_NONE && !ble_post(NULL, BLE_EV_START, 1));
    ble_init(NULL);
}

// ── B4e: abuse bounds ─────────────────────────────────────────────────────────────────────────────
static void to_channel_up(ble_t *b, uint64_t t);

static void test_churn_is_counted_per_link_and_proven_by_tls(void)
{
    ble_t b;
    to_channel_up(&b, 1000);
    CHECK(b.churn == 0 && !ble_churn_exceeded(&b));
    CHECK(ble_post(&b, BLE_EV_CHANNEL_CLOSED, 1100) && b.churn == 1);                     // a channel that opened and closed without reaching TLS_UP
    ble_post(&b, BLE_EV_CHANNEL_OPEN, 1200);
    CHECK(ble_handshake_failed(&b, false, 1300) == BLE_EV_TLS_FAIL && b.churn == 2);      // a failed handshake is one too
    CHECK(!ble_churn_exceeded(&b));
    ble_post(&b, BLE_EV_CHANNEL_OPEN, 1400);
    ble_post(&b, BLE_EV_CHANNEL_CLOSED, 1500);
    CHECK(b.churn == BLE_CHURN_LIMIT && ble_churn_exceeded(&b));                          // the third: the glue ends the link
    // alerts count as well
    to_channel_up(&b, 2000);
    ble_handshake_failed(&b, true, 2100);
    ble_post(&b, BLE_EV_CHANNEL_OPEN, 2200);
    ble_handshake_failed(&b, true, 2300);
    ble_post(&b, BLE_EV_CHANNEL_OPEN, 2400);
    CHECK(ble_handshake_failed(&b, true, 2500) == BLE_EV_TLS_REFUSED && ble_churn_exceeded(&b));
    // TLS_UP proves the peer: the count restarts, and later closes of an established link are not counted
    to_channel_up(&b, 3000);
    ble_post(&b, BLE_EV_CHANNEL_CLOSED, 3100);
    ble_post(&b, BLE_EV_CHANNEL_OPEN, 3200);
    CHECK(b.churn == 1 && ble_post(&b, BLE_EV_TLS_UP, 3300) && b.churn == 0);
    for (int i = 0; i < 10; i++) {
        ble_post(&b, BLE_EV_CHANNEL_CLOSED, 3400 + 100 * i);                              // the phone closes and reopens, TLS each time
        ble_post(&b, BLE_EV_CHANNEL_OPEN, 3450 + 100 * i);
        ble_post(&b, BLE_EV_TLS_UP, 3460 + 100 * i);
    }
    CHECK(b.churn == 0 && !ble_churn_exceeded(&b));
    // a closed channel from CONNECTED (nothing was open) is not churn; a new LINK_UP starts from zero
    to_channel_up(&b, 4000);
    ble_post(&b, BLE_EV_CHANNEL_CLOSED, 4100);
    ble_post(&b, BLE_EV_CHANNEL_CLOSED, 4200);
    CHECK(b.churn == 1);
    ble_post(&b, BLE_EV_LINK_DOWN, 4300);
    ble_post(&b, BLE_EV_LINK_UP, 4400);
    CHECK(b.churn == 0);
    CHECK(!ble_churn_exceeded(NULL));
    // the counter saturates, it never wraps to "fine"
    to_channel_up(&b, 5000);
    for (int i = 0; i < 600; i++) { ble_post(&b, BLE_EV_CHANNEL_CLOSED, 5100 + i); ble_post(&b, BLE_EV_CHANNEL_OPEN, 5100 + i); }
    CHECK(b.churn == 255 && ble_churn_exceeded(&b));
}

static void test_a_peer_that_is_not_trusted_is_dropped_when_idle(void)
{
    ble_t b;
    ble_init(&b);
    ble_post(&b, BLE_EV_START, 0);
    ble_post(&b, BLE_EV_LINK_UP, 1000);
    ble_post(&b, BLE_EV_ENCRYPTED, 1200);                                                // dev build: "encrypted" at once, the peer is not trusted
    CHECK(b.state == BLE_ST_CONNECTED && !b.trusted);
    CHECK(ble_poll(&b, 1200 + BLE_IDLE_CAP_MS - 1) == BLE_EV_NONE);
    CHECK(ble_poll(&b, 1200 + BLE_IDLE_CAP_MS) == BLE_EV_IDLE_TIMEOUT);
    CHECK(ble_post(&b, BLE_EV_IDLE_TIMEOUT, 1200 + BLE_IDLE_CAP_MS) && b.state == BLE_ST_ADVERTISING);
    // a trusted peer may keep the link and wait for the channel as long as it likes
    ble_post(&b, BLE_EV_LINK_UP, 20000);
    ble_set_trusted(&b, true);
    ble_post(&b, BLE_EV_ENCRYPTED, 20100);
    CHECK(b.state == BLE_ST_CONNECTED && b.trusted);
    CHECK(ble_poll(&b, 20100 + 3600000) == BLE_EV_NONE);
    // the trust is per link
    ble_post(&b, BLE_EV_LINK_DOWN, 30000);
    CHECK(!b.trusted);
    ble_post(&b, BLE_EV_LINK_UP, 31000);
    CHECK(!b.trusted);
    // an open channel is bounded by the handshake, not by the idle cap
    to_channel_up(&b, 40000);
    CHECK(ble_poll(&b, 40000 + BLE_IDLE_CAP_MS) == BLE_EV_TLS_FAIL);
    // IDLE_TIMEOUT changes nothing outside CONNECTED
    ble_init(&b);
    ble_post(&b, BLE_EV_START, 0);
    CHECK(!ble_post(&b, BLE_EV_IDLE_TIMEOUT, 10) && b.state == BLE_ST_ADVERTISING);
    ble_set_trusted(NULL, true);
    // L2: a link that arrives just after the advertising timer fired is a link
    ble_init(&b);
    ble_post(&b, BLE_EV_START, 0);
    ble_post(&b, BLE_EV_ADV_TIMEOUT, 30000);
    CHECK(b.state == BLE_ST_NOT_FOUND);
    CHECK(ble_post(&b, BLE_EV_LINK_UP, 30001) && b.state == BLE_ST_SECURING && b.since_ms == 30001);
}

static void test_the_refused_wait_escalates_only_for_a_trusted_peer(void)
{
    net_backoff_t ladder;
    net_backoff_reset(&ladder);
    for (int i = 0; i < 20; i++) CHECK(ble_refused_wait_ms(false, &ladder, 12345u * (unsigned)i) == BLE_COOLDOWN_MS);   // flat, no random, no ladder
    CHECK(ladder.attempt == 0);
    // a trusted peer gets the refused ladder of net_state.h (30, 60, 120, 300 s, each with jitter)
    const uint32_t base[] = {30000, 60000, 120000, 300000, 300000};
    for (unsigned i = 0; i < 5; i++) {
        const uint32_t w = ble_refused_wait_ms(true, &ladder, 777u);
        CHECK(w >= base[i] - base[i] / 4 && w <= base[i] + base[i] / 4);
    }
    CHECK(ble_refused_wait_ms(false, NULL, 1) == BLE_COOLDOWN_MS && ble_refused_wait_ms(true, NULL, 1) == BLE_COOLDOWN_MS);
}

// ── B4e: new bonds only inside an explicit pairing window, never by evicting one ───────────────────
static void test_the_pairing_window(void)
{
    ble_pair_window_t w;
    ble_pair_init(&w);
    CHECK(!ble_pair_is_open(&w, 0) && !ble_pair_is_open(&w, 123456789));                  // closed by default
    CHECK(!ble_bond_allowed(&w, 1000, false));
    ble_pair_open(&w, 5000);
    CHECK(ble_pair_is_open(&w, 5000) && ble_pair_is_open(&w, 5000 + BLE_PAIR_WINDOW_MS - 1));
    CHECK(!ble_pair_is_open(&w, 5000 + BLE_PAIR_WINDOW_MS));                              // closes at 120.0 s
    CHECK(!ble_pair_is_open(&w, 5000 + BLE_PAIR_WINDOW_MS + 1));
    ble_pair_close(&w);
    CHECK(!ble_pair_is_open(&w, 6000));                                                   // closed by hand
    ble_pair_open(&w, 7000);
    ble_pair_open(&w, 50000);                                                             // opening again restarts the 120 s
    CHECK(ble_pair_is_open(&w, 50000 + BLE_PAIR_WINDOW_MS - 1) && !ble_pair_is_open(&w, 50000 + BLE_PAIR_WINDOW_MS));
    CHECK(!ble_pair_is_open(&w, 49999));                                                  // a clock that stepped back before the window opened: closed, the safe side
    // a clock that wrapped far back closes it rather than holding it open for ever
    ble_pair_open(&w, 1000000);
    CHECK(!ble_pair_is_open(&w, 10));
    // a new bond needs the window AND room: a full store never evicts, window or not
    ble_pair_open(&w, 2000000);
    CHECK(ble_bond_allowed(&w, 2000001, false));
    CHECK(!ble_bond_allowed(&w, 2000001, true));
    CHECK(!ble_bond_allowed(&w, 2000000 + BLE_PAIR_WINDOW_MS, false));
    CHECK(!ble_bond_allowed(NULL, 1, false) && !ble_pair_is_open(NULL, 1));
    ble_pair_open(NULL, 1);
    ble_pair_close(NULL);
    ble_pair_init(NULL);
}

// ── B4d: advertising does not stay stopped ──────────────────────────────────────────────────────────
// No phone for an hour: 30 s on the air, 2 minutes off, again. A wake (the link task posts START on a touch or the PWR button) restarts it at once.
static void test_advertising_restarts_by_itself_and_on_a_wake(void)
{
    ble_t b;
    ble_init(&b);
    ble_post(&b, BLE_EV_START, 0);
    unsigned starts = 1, not_found = 0;
    uint64_t on_air_ms = 0, last_on = 0;
    for (uint64_t now = 0; now <= 3600000; now += 50) {      // the link task's 50 ms tick, an hour
        const ble_event_t due = ble_poll(&b, now);
        if (due == BLE_EV_ADV_TIMEOUT) {
            on_air_ms += now - last_on;
            ble_post(&b, due, now);
            not_found++;
            CHECK(b.state == BLE_ST_NOT_FOUND);
        } else if (due == BLE_EV_START) {
            ble_post(&b, due, now);
            starts++;
            last_on = now;
            CHECK(b.state == BLE_ST_ADVERTISING);
        }
    }
    // one cycle is 30 s on and 120 s off: 150 s, so 24 cycles in an hour, and the radio is on a fifth of the time
    CHECK(not_found == 24 && starts == 25);
    CHECK(on_air_ms == (uint64_t)24 * BLE_ADV_TIMEOUT_MS);
    CHECK(on_air_ms * 100 / 3600000 == 20);
    // a wake in the quiet part: advertising at once, with a fresh 30 s
    ble_init(&b);
    ble_post(&b, BLE_EV_START, 0);
    ble_post(&b, BLE_EV_ADV_TIMEOUT, 30000);
    CHECK(b.state == BLE_ST_NOT_FOUND);
    CHECK(ble_post(&b, BLE_EV_START, 50000) && b.state == BLE_ST_ADVERTISING && b.since_ms == 50000);
    CHECK(ble_poll(&b, 50000 + 29999) == BLE_EV_NONE && ble_poll(&b, 50000 + 30000) == BLE_EV_ADV_TIMEOUT);
    // a wake while advertising or connected changes nothing and does not stretch the 30 s
    CHECK(!ble_post(&b, BLE_EV_START, 60000) && b.since_ms == 50000);
    ble_post(&b, BLE_EV_LINK_UP, 61000);
    CHECK(!ble_post(&b, BLE_EV_START, 62000) && b.state == BLE_ST_SECURING);
    // wake after wake after wake: each is a START from NOT_FOUND, and the 30 s on-air window bounds the radio (no storm of state changes)
    ble_init(&b);
    ble_post(&b, BLE_EV_START, 0);
    ble_post(&b, BLE_EV_ADV_TIMEOUT, 30000);
    unsigned changes = 0;
    for (uint64_t now = 30000; now < 150000; now += 1000) {  // a touch every second for 2 minutes
        if (b.state == BLE_ST_NOT_FOUND) { CHECK(ble_post(&b, BLE_EV_START, now)); changes++; }
        const ble_event_t due = ble_poll(&b, now);
        if (due == BLE_EV_ADV_TIMEOUT) { ble_post(&b, due, now); changes++; }
    }
    CHECK(changes <= 2 * (120000 / BLE_ADV_TIMEOUT_MS) + 2);
}

static void test_post_keeps_the_clock_of_a_state_that_did_not_change(void)
{
    ble_t b;
    ble_init(&b);
    ble_post(&b, BLE_EV_START, 100);
    CHECK(!ble_post(&b, BLE_EV_START, 5000) && b.since_ms == 100);           // a second START in ADVERTISING does not restart the 30 s
    CHECK(!ble_post(&b, BLE_EV_ENCRYPTED, 6000) && b.since_ms == 100);
    ble_post(&b, BLE_EV_LINK_UP, 7000);
    CHECK(!ble_post(&b, BLE_EV_LINK_UP, 7100) && b.since_ms == 7000);        // one connection: a second LINK_UP changes nothing
    CHECK(!ble_post(&b, BLE_EV_CHANNEL_OPEN, 7200) && b.state == BLE_ST_SECURING);   // a channel before encryption is refused by the policy; no state change
    CHECK(!ble_post(&b, (ble_event_t)99, 7300) && b.state == BLE_ST_SECURING);
    // time that goes backwards is held at the newest reading
    ble_init(&b);
    ble_post(&b, BLE_EV_START, 9000);
    ble_post(&b, BLE_EV_LINK_UP, 4000);
    CHECK(b.since_ms == 9000);
}

// ── refusals in a row: three TLS alerts, one key refused ───────────────────────────────────────────
static void to_channel_up(ble_t *b, uint64_t t)
{
    ble_init(b);
    ble_post(b, BLE_EV_START, t);
    ble_post(b, BLE_EV_LINK_UP, t);
    ble_post(b, BLE_EV_ENCRYPTED, t);
    ble_post(b, BLE_EV_CHANNEL_OPEN, t);
    assert(b->state == BLE_ST_CHANNEL_UP);
}

static void test_refusal_run(void)
{
    ble_t b;
    to_channel_up(&b, 1000);
    // two alerts: ordinary failures, back to waiting for a channel
    CHECK(ble_handshake_failed(&b, true, 2000) == BLE_EV_TLS_FAIL && b.state == BLE_ST_CONNECTED);
    ble_post(&b, BLE_EV_CHANNEL_OPEN, 2100);
    CHECK(ble_handshake_failed(&b, true, 3000) == BLE_EV_TLS_FAIL && b.state == BLE_ST_CONNECTED);
    ble_post(&b, BLE_EV_CHANNEL_OPEN, 3100);
    // the third in a row is a refusal
    CHECK(ble_handshake_failed(&b, true, 4000) == BLE_EV_TLS_REFUSED && b.state == BLE_ST_AUTH_FAILED);
    CHECK(ble_post(&b, BLE_EV_LINK_DOWN, 4100) && b.state == BLE_ST_ADVERTISING);

    // a failure that is not an alert breaks the run
    to_channel_up(&b, 1000);
    ble_handshake_failed(&b, true, 2000);
    ble_post(&b, BLE_EV_CHANNEL_OPEN, 2100);
    ble_handshake_failed(&b, true, 3000);
    ble_post(&b, BLE_EV_CHANNEL_OPEN, 3100);
    CHECK(ble_handshake_failed(&b, false, 4000) == BLE_EV_TLS_FAIL && b.state == BLE_ST_CONNECTED);   // a timeout, a reset
    ble_post(&b, BLE_EV_CHANNEL_OPEN, 4100);
    CHECK(ble_handshake_failed(&b, true, 5000) == BLE_EV_TLS_FAIL);        // the run starts again at one
    ble_post(&b, BLE_EV_CHANNEL_OPEN, 5100);
    CHECK(ble_handshake_failed(&b, true, 6000) == BLE_EV_TLS_FAIL);
    ble_post(&b, BLE_EV_CHANNEL_OPEN, 6100);
    CHECK(ble_handshake_failed(&b, true, 7000) == BLE_EV_TLS_REFUSED);

    // the counter resets when the link comes up (TLS_UP)
    to_channel_up(&b, 1000);
    ble_handshake_failed(&b, true, 2000);
    ble_post(&b, BLE_EV_CHANNEL_OPEN, 2100);
    ble_handshake_failed(&b, true, 3000);
    ble_post(&b, BLE_EV_CHANNEL_OPEN, 3100);
    CHECK(ble_post(&b, BLE_EV_TLS_UP, 3500) && b.state == BLE_ST_TLS_UP && b.refusals.refusals == 0);
    CHECK(ble_post(&b, BLE_EV_CHANNEL_CLOSED, 4000) && b.state == BLE_ST_CONNECTED);
    ble_post(&b, BLE_EV_CHANNEL_OPEN, 4100);
    CHECK(ble_handshake_failed(&b, true, 5000) == BLE_EV_TLS_FAIL && b.state == BLE_ST_CONNECTED);   // not the third: the two before were forgiven

    // a handshake deadline (poll says TLS_FAIL) is an ordinary failure, not a refusal, and breaks the run
    to_channel_up(&b, 1000);
    ble_handshake_failed(&b, true, 2000);
    ble_post(&b, BLE_EV_CHANNEL_OPEN, 2100);
    ble_handshake_failed(&b, true, 3000);
    ble_post(&b, BLE_EV_CHANNEL_OPEN, 3100);
    CHECK(ble_poll(&b, 3100 + 5000) == BLE_EV_TLS_FAIL);
    CHECK(ble_handshake_failed(&b, false, 8100) == BLE_EV_TLS_FAIL && b.refusals.refusals == 0);

    // START clears the run too: a new session starts from zero
    to_channel_up(&b, 1000);
    ble_handshake_failed(&b, true, 2000);
    ble_post(&b, BLE_EV_STOP, 2100);
    ble_post(&b, BLE_EV_START, 2200);
    CHECK(b.refusals.refusals == 0);
    // a handshake failure while no handshake is running (not in CHANNEL_UP) is ignored: no event, no state change, nothing counted
    ble_init(&b);
    ble_post(&b, BLE_EV_START, 1);
    CHECK(ble_handshake_failed(&b, true, 2) == BLE_EV_NONE && b.state == BLE_ST_ADVERTISING && b.refusals.refusals == 0);
    CHECK(ble_handshake_failed(NULL, true, 2) == BLE_EV_NONE);
}

// ── the accept policy: only an authenticated, bonded peer on a long-key encrypted link gets the channel ───────────────────────
static ble_sec_t sec(bool enc, bool bonded, bool auth, unsigned key) { ble_sec_t s = { enc, bonded, auth, (uint8_t)key }; return s; }

static void test_accept_policy(void)
{
    // the predicate: every combination of the three flags and the key sizes around the limit; trusted only when ALL hold
    static const unsigned keys[] = {0, 1, 15, 16, 17, 32};
    for (unsigned m = 0; m < 8; m++)
        for (unsigned k = 0; k < sizeof keys / sizeof keys[0]; k++) {
            const ble_sec_t s = sec(m & 1, m & 2, m & 4, keys[k]);
            CHECK(ble_sec_trusted(&s) == (m == 7 && keys[k] >= 16));
        }
    CHECK(!ble_sec_trusted(NULL));
    // product: trusted and one channel
    ble_sec_t s = sec(true, true, true, 16);
    CHECK(ble_accept_check(&s, false, false) == BLE_ACCEPT_OK);
    s = sec(true, true, true, 15);   CHECK(ble_accept_check(&s, false, false) == BLE_ACCEPT_REFUSE_ENC);     // a short key
    s = sec(true, true, false, 16);  CHECK(ble_accept_check(&s, false, false) == BLE_ACCEPT_REFUSE_ENC);     // Just Works: encrypted and bonded, not authenticated
    s = sec(true, false, true, 16);  CHECK(ble_accept_check(&s, false, false) == BLE_ACCEPT_REFUSE_ENC);     // authenticated pairing that was not saved
    s = sec(false, true, true, 16);  CHECK(ble_accept_check(&s, false, false) == BLE_ACCEPT_REFUSE_ENC);     // this link is not encrypted
    s = sec(false, false, false, 0); CHECK(ble_accept_check(&s, false, false) == BLE_ACCEPT_REFUSE_ENC);
    CHECK(ble_accept_check(NULL, false, false) == BLE_ACCEPT_REFUSE_ENC);                                      // nothing known about the link: refuse
    s = sec(true, true, true, 16);
    CHECK(ble_accept_check(&s, false, true) == BLE_ACCEPT_REFUSE_SECOND);                                      // second channel
    s = sec(false, false, false, 0);
    CHECK(ble_accept_check(&s, false, true) == BLE_ACCEPT_REFUSE_SECOND);                                      // ranks first
    // the dev flag (BLE_DEV_ALLOW_UNBONDED, off in every product config) waives the whole security rule, never the one-channel rule
    CHECK(ble_accept_check(&s, true, false) == BLE_ACCEPT_OK && ble_accept_check(NULL, true, false) == BLE_ACCEPT_OK);
    CHECK(ble_accept_check(&s, true, true) == BLE_ACCEPT_REFUSE_SECOND);
    CHECK(ble_encryption_required(false) && !ble_encryption_required(true));
}

// ── the advertising bytes, against the vector file ──────────────────────────────────────────────────
static size_t unhex(const char *hex, uint8_t *out, size_t cap)
{
    size_t n = 0;
    // a field ends at a tab or a line end; a CRLF checkout (git archive on Windows) ends it with \r\n
    while (hex[0] && hex[0] != '\t' && hex[0] != '\n' && hex[0] != '\r' && hex[1]) {
        assert(n < cap);
        unsigned v;
        assert(sscanf(hex, "%2x", &v) == 1);
        out[n++] = (uint8_t)v;
        hex += 2;
    }
    return n;
}

static void test_advertising_against_the_vectors(const char *path)
{
    FILE *f = fopen(path, "r");
    assert(f);
    char line[512];
    unsigned adv_lines = 0, uuid_lines = 0;
    uint8_t want[64];
    while (fgets(line, sizeof line, f)) {
        if (strncmp(line, "uuid\tservice\t", 13) == 0) {
            // uuid <role> <uuid> <little-endian bytes>
            const char *le = strrchr(line, '\t') + 1;
            const size_t n = unhex(le, want, sizeof want);
            CHECK(n == 16 && memcmp(want, BLE_SERVICE_UUID_LE, 16) == 0);
            uuid_lines++;
        } else if (strncmp(line, "adv\t", 4) == 0) {
            // adv <mac> <name> <adv-hex> <scan-response-hex>
            char *fields[5] = {0};
            unsigned k = 0;
            for (char *s = line; k < 5; ) {
                fields[k++] = s;
                char *tab = strchr(s, '\t');
                if (!tab) break;
                *tab = 0;
                s = tab + 1;
            }
            assert(k == 5);
            char name[32];
            CHECK(ble_adv_name(fields[1], name, sizeof name));
            CHECK(strcmp(name, fields[2]) == 0);
            uint8_t adv[31], rsp[31];
            const size_t adv_n = ble_adv_data(fields[1], adv, sizeof adv), rsp_n = ble_scan_rsp_data(rsp, sizeof rsp);
            const size_t want_adv = unhex(fields[3], want, sizeof want);
            CHECK(adv_n == want_adv && memcmp(adv, want, want_adv) == 0);
            const size_t want_rsp = unhex(fields[4], want, sizeof want);
            CHECK(rsp_n == want_rsp && memcmp(rsp, want, want_rsp) == 0);
            adv_lines++;
        }
    }
    fclose(f);
    CHECK(uuid_lines == 1 && adv_lines >= 5);
    // bad input: no name, no bytes, never past the buffer
    char name[32];
    uint8_t buf[31];
    CHECK(!ble_adv_name(NULL, name, sizeof name) && !ble_adv_name("B8:1F:3F:CA:E5:58", NULL, 10) && !ble_adv_name("B8:1F:3F:CA:E5:58", name, 17));
    CHECK(ble_adv_name("B8:1F:3F:CA:E5:58", name, 18) && strcmp(name, "harness-dial-e558") == 0);
    CHECK(!ble_adv_name("B8:1F:3F:CA:E5", name, sizeof name) && name[0] == 0);          // five bytes
    CHECK(!ble_adv_name("B8:1F:3F:CA:E5:5", name, sizeof name));                         // a short last byte
    CHECK(!ble_adv_name("B8:1F:3F:CA:E5:5G", name, sizeof name));                        // not hex
    CHECK(!ble_adv_name("B8-1F-3F-CA-E5-58", name, sizeof name));                        // wrong separator
    CHECK(!ble_adv_name("B8:1F:3F:CA:E5:58:00", name, sizeof name));                     // too long
    CHECK(ble_adv_name("b8:1f:3f:ca:e5:5A", name, sizeof name) && strcmp(name, "harness-dial-e55a") == 0);   // either case in, lower case out
    CHECK(ble_adv_data("nope", buf, sizeof buf) == 0 && ble_adv_data("B8:1F:3F:CA:E5:58", buf, 21) == 0 && ble_adv_data("B8:1F:3F:CA:E5:58", buf, 22) == 22);
    CHECK(ble_adv_data("B8:1F:3F:CA:E5:58", NULL, 31) == 0);
    CHECK(ble_scan_rsp_data(buf, 17) == 0 && ble_scan_rsp_data(buf, 18) == 18 && ble_scan_rsp_data(NULL, 31) == 0);
}

// ── B4c: the two writable characteristics (spec section 5), against the `status` and `hint` lines of the vector file ─────────────────────
// hint <written-bytes-hex|empty> <ok:N|err:0xHH>      status <value-hex> <state-name>
static void test_gatt_values_against_the_vectors(const char *path)
{
    FILE *f = fopen(path, "r");
    assert(f);
    char line[256];
    unsigned hints = 0, statuses = 0;
    while (fgets(line, sizeof line, f)) {
        line[strcspn(line, "\r\n")] = 0;
        char *fields[3] = {0};
        unsigned k = 0;
        for (char *s = line; k < 3; ) {   // a split that keeps an empty field (a zero-length write)
            fields[k++] = s;
            char *tab = strchr(s, '	');
            if (!tab) break;
            *tab = 0;
            s = tab + 1;
        }
        if (strcmp(fields[0], "hint") == 0 && k == 3) {
            uint8_t data[8];
            const size_t n = unhex(fields[1], data, sizeof data);
            uint8_t value = 0xEE;
            const uint8_t err = ble_hint_check(n ? data : NULL, n, &value);
            if (strncmp(fields[2], "ok:", 3) == 0) {
                CHECK(err == 0 && value == (uint8_t)atoi(fields[2] + 3));
            } else {
                CHECK(strncmp(fields[2], "err:", 4) == 0 && err == (uint8_t)strtoul(fields[2] + 4, NULL, 16) && value == 0xEE);   // an error stores nothing
            }
            hints++;
        } else if (strcmp(fields[0], "status") == 0 && k == 3) {
            uint8_t v;
            CHECK(unhex(fields[1], &v, 1) == 1);
            CHECK(strcmp(ble_relay_status_name(v), fields[2]) == 0);
            statuses++;
        }
    }
    fclose(f);
    CHECK(hints >= 6 && statuses >= 8);
    // the edges the file does not list
    uint8_t v = 7;
    const uint8_t two[2] = {1, 0};
    CHECK(ble_hint_check(two, 2, &v) == BLE_HINT_ERR_LEN && v == 7);                  // two bytes, even when the first is valid
    CHECK(ble_hint_check(NULL, 1, &v) == BLE_HINT_ERR_LEN);                           // a missing buffer is no value
    CHECK(ble_hint_check(two, 1, NULL) == 0);                                         // the caller may only ask whether it would be accepted
    CHECK(ble_hint_check(two, 0, &v) == BLE_HINT_ERR_LEN);
    CHECK(BLE_HINT_ERR_LEN == 0x0D && BLE_HINT_ERR_RANGE == 0x80);
    // a status write is one byte, any value; the dial shows it and never treats it as an error
    uint8_t s = 9;
    CHECK(ble_relay_status_check(two, 1, &s) == 0 && s == 1);
    const uint8_t big = 0xFE;
    CHECK(ble_relay_status_check(&big, 1, &s) == 0 && s == 0xFE);
    CHECK(ble_relay_status_check(two, 2, &s) == BLE_HINT_ERR_LEN && s == 0xFE);
    CHECK(ble_relay_status_check(two, 0, &s) == BLE_HINT_ERR_LEN && ble_relay_status_check(NULL, 1, &s) == BLE_HINT_ERR_LEN);
}

// ── B5: the number on the screen. The window opens the offer, the answer closes it, and the 3 s encryption deadline waits while it is on show ──
static void test_the_numeric_comparison_offer(void)
{
    ble_pair_window_t w;
    ble_pair_init(&w);
    // closed: a pairing that wants a number is refused at once (and so is one at exactly 120.0 s)
    CHECK(ble_numcmp_request(&w, 1000) == BLE_NUMCMP_REFUSE && ble_numcmp_request(NULL, 1000) == BLE_NUMCMP_REFUSE);
    ble_pair_open(&w, 5000);
    CHECK(ble_numcmp_request(&w, 5000) == BLE_NUMCMP_SHOW && ble_numcmp_request(&w, 5000 + BLE_PAIR_WINDOW_MS - 1) == BLE_NUMCMP_SHOW);
    CHECK(ble_numcmp_request(&w, 5000 + BLE_PAIR_WINDOW_MS) == BLE_NUMCMP_REFUSE);
    // the verdict while the number is shown: no answer waits, Yes accepts, No rejects
    CHECK(ble_numcmp_verdict(&w, 6000, -1) == BLE_PAIR_WAIT);
    CHECK(ble_numcmp_verdict(&w, 6000, 1) == BLE_PAIR_ACCEPT);
    CHECK(ble_numcmp_verdict(&w, 6000, 0) == BLE_PAIR_REJECT);
    CHECK(ble_numcmp_verdict(&w, 6000, 2) == BLE_PAIR_WAIT && ble_numcmp_verdict(&w, 6000, -7) == BLE_PAIR_WAIT);   // nothing but 0 and 1 is an answer
    // the window ends under the number: waiting is over at 120.0 s, and a late Yes is a No
    CHECK(ble_numcmp_verdict(&w, 5000 + BLE_PAIR_WINDOW_MS - 1, -1) == BLE_PAIR_WAIT);
    CHECK(ble_numcmp_verdict(&w, 5000 + BLE_PAIR_WINDOW_MS, -1) == BLE_PAIR_REJECT);
    CHECK(ble_numcmp_verdict(&w, 5000 + BLE_PAIR_WINDOW_MS, 1) == BLE_PAIR_REJECT);
    // a window closed by hand (or by Forget) under the number: rejected, whatever the answer
    ble_pair_close(&w);
    CHECK(ble_numcmp_verdict(&w, 6000, -1) == BLE_PAIR_REJECT && ble_numcmp_verdict(&w, 6000, 1) == BLE_PAIR_REJECT);
    CHECK(ble_numcmp_verdict(NULL, 6000, 1) == BLE_PAIR_REJECT);
    // a "No" closes the window: a second try needs the user to open it again (the glue calls ble_pair_close on REJECT; this is the pure half)
    ble_pair_open(&w, 7000);
    CHECK(ble_numcmp_verdict(&w, 7100, 0) == BLE_PAIR_REJECT);
    ble_pair_close(&w);
    CHECK(ble_numcmp_request(&w, 7200) == BLE_NUMCMP_REFUSE && !ble_bond_allowed(&w, 7200, false));
}

static void test_the_encryption_deadline_waits_for_the_number(void)
{
    ble_t b;
    ble_init(&b);
    ble_post(&b, BLE_EV_START, 0);
    ble_post(&b, BLE_EV_LINK_UP, 1000);
    CHECK(ble_poll(&b, 1000 + BLE_ENC_DEADLINE_MS - 1) == BLE_EV_NONE && ble_poll(&b, 1000 + BLE_ENC_DEADLINE_MS) == BLE_EV_ENC_TIMEOUT);   // unchanged without a number
    ble_set_prompting(&b, true);
    CHECK(ble_poll(&b, 1000 + BLE_ENC_DEADLINE_MS) == BLE_EV_NONE);                          // the number is on the glass: the 3 s do not run out
    CHECK(ble_poll(&b, 1000 + BLE_PAIR_WINDOW_MS + 60000) == BLE_EV_NONE);                   // the pairing window (glue) ends the offer, not this timer
    ble_set_prompting(&b, false);
    CHECK(ble_poll(&b, 1000 + BLE_ENC_DEADLINE_MS) == BLE_EV_ENC_TIMEOUT);                   // answered or withdrawn: the old deadline is due again
    // it holds nothing else: leaving SECURING ends the offer, and an untrusted peer still has the idle cap
    ble_set_prompting(&b, true);
    ble_post(&b, BLE_EV_ENCRYPTED, 2000);
    CHECK(b.state == BLE_ST_CONNECTED && !b.prompting);
    CHECK(ble_poll(&b, 2000 + BLE_IDLE_CAP_MS) == BLE_EV_IDLE_TIMEOUT);
    ble_set_prompting(&b, true);
    CHECK(ble_poll(&b, 2000 + BLE_IDLE_CAP_MS) == BLE_EV_IDLE_TIMEOUT);                      // a flag in the wrong state holds nothing
    // a lost link, and a new one, start without an offer
    ble_init(&b);
    ble_post(&b, BLE_EV_START, 0);
    ble_post(&b, BLE_EV_LINK_UP, 10);
    ble_set_prompting(&b, true);
    ble_post(&b, BLE_EV_LINK_DOWN, 20);
    CHECK(!b.prompting && b.state == BLE_ST_ADVERTISING);
    ble_post(&b, BLE_EV_LINK_UP, 30);
    CHECK(!b.prompting && ble_poll(&b, 30 + BLE_ENC_DEADLINE_MS) == BLE_EV_ENC_TIMEOUT);
    ble_set_prompting(NULL, true);
    // the offer is bounded from outside: the window rejects it at 120.0 s, so the link is held no longer than the window the user opened
    ble_pair_window_t w;
    ble_pair_init(&w);
    ble_pair_open(&w, 0);
    CHECK(ble_numcmp_verdict(&w, 119000, -1) == BLE_PAIR_WAIT && ble_numcmp_verdict(&w, BLE_PAIR_WINDOW_MS, -1) == BLE_PAIR_REJECT);
}

// B5 screen: the countdown the Phone screen shows is the time left in the window, rounded UP to whole seconds by the screen, in ms here.
static void test_the_window_time_left(void)
{
    ble_pair_window_t w;
    ble_pair_init(&w);
    CHECK(ble_pair_left_ms(&w, 0) == 0 && ble_pair_left_ms(NULL, 0) == 0);                                  // closed: nothing left
    ble_pair_open(&w, 5000);
    CHECK(ble_pair_left_ms(&w, 5000) == BLE_PAIR_WINDOW_MS);
    CHECK(ble_pair_left_ms(&w, 5000 + 1) == BLE_PAIR_WINDOW_MS - 1);
    CHECK(ble_pair_left_ms(&w, 5000 + BLE_PAIR_WINDOW_MS - 1) == 1);
    CHECK(ble_pair_left_ms(&w, 5000 + BLE_PAIR_WINDOW_MS) == 0);                                            // 120.0 s: over, like ble_pair_is_open
    CHECK(ble_pair_left_ms(&w, 5000 + BLE_PAIR_WINDOW_MS + 99999) == 0);
    CHECK(ble_pair_left_ms(&w, 4999) == 0);                                                                  // a clock that stepped back: closed, like ble_pair_is_open
    ble_pair_close(&w);
    CHECK(ble_pair_left_ms(&w, 6000) == 0);
}

// Review M1: a number that stays on the screen is withdrawn after BLE_PROMPT_MAX_MS, whatever the window says, and a Yes that arrives after it is a No.
static void test_the_number_is_shown_for_a_bounded_time(void)
{
    ble_pair_window_t w;
    ble_pair_init(&w);
    ble_pair_open(&w, 1000);
    CHECK(BLE_PROMPT_MAX_MS == 30000 && BLE_PROMPT_MAX_MS < BLE_PAIR_WINDOW_MS);
    const uint64_t shown = 2000;
    CHECK(ble_prompt_verdict(&w, shown, shown, -1) == BLE_PAIR_WAIT);
    CHECK(ble_prompt_verdict(&w, shown, shown + BLE_PROMPT_MAX_MS - 1, -1) == BLE_PAIR_WAIT);
    CHECK(ble_prompt_verdict(&w, shown, shown + BLE_PROMPT_MAX_MS, -1) == BLE_PAIR_REJECT);          // 30.0 s: over, like the window's own end
    CHECK(ble_prompt_verdict(&w, shown, shown + BLE_PROMPT_MAX_MS, 1) == BLE_PAIR_REJECT);           // a late Yes is a No
    CHECK(ble_prompt_verdict(&w, shown, shown + BLE_PROMPT_MAX_MS - 1, 1) == BLE_PAIR_ACCEPT);
    CHECK(ble_prompt_verdict(&w, shown, shown + 10, 0) == BLE_PAIR_REJECT);
    CHECK(ble_prompt_verdict(&w, shown, 1000 + BLE_PAIR_WINDOW_MS, -1) == BLE_PAIR_REJECT);          // the window rule still holds
    CHECK(ble_prompt_verdict(&w, shown, shown - 1, 1) == BLE_PAIR_REJECT);                           // a clock that stepped back: the safe side
    CHECK(ble_prompt_verdict(NULL, shown, shown, 1) == BLE_PAIR_REJECT);
}

// Review M2: a bond that is not an authenticated, long-keyed one (Just Works) is deleted at once; it must not fill the two slots.
static void test_a_weak_bond_is_unwanted(void)
{
    for (unsigned m = 0; m < 16; m++) {
        for (unsigned k = 0; k < 2; k++) {
            ble_sec_t s = {.encrypted = m & 1, .bonded = m & 2, .authenticated = m & 4, .key_size = k ? 16 : 15};
            if (m & 8) s.key_size = 0;
            CHECK(ble_bond_unwanted(&s) == (s.bonded && !ble_sec_trusted(&s)));
        }
    }
    const ble_sec_t good = {.encrypted = true, .bonded = true, .authenticated = true, .key_size = 16};
    const ble_sec_t just_works = {.encrypted = true, .bonded = true, .authenticated = false, .key_size = 16};
    const ble_sec_t short_key = {.encrypted = true, .bonded = true, .authenticated = true, .key_size = 7};
    const ble_sec_t no_bond = {.encrypted = true, .bonded = false, .authenticated = false, .key_size = 16};
    CHECK(!ble_bond_unwanted(&good) && ble_bond_unwanted(&just_works) && ble_bond_unwanted(&short_key));
    CHECK(!ble_bond_unwanted(&no_bond));    // nothing was stored: nothing to delete (the channel rule refuses it anyway)
    CHECK(!ble_bond_unwanted(NULL));
}

// Pairing fix (2026-11-09, user-approved): the pair window opens by itself when the link comes up with phone mode on and NO bond stored, because no touch path
// reaches Settings > Phone > Pair on a real dial. With a bond the window stays shut.
static void test_the_pair_window_opens_by_itself_only_when_unbonded(void)
{
    CHECK(ble_pair_auto_open_wanted(true, 0));        // phone mode on, no bond: open
    CHECK(!ble_pair_auto_open_wanted(true, 1));       // a bond exists: never
    CHECK(!ble_pair_auto_open_wanted(true, 2));       // the store is full: never
    CHECK(!ble_pair_auto_open_wanted(false, 0));      // phone mode off: never
    CHECK(!ble_pair_auto_open_wanted(false, 1));
    CHECK(!ble_pair_auto_open_wanted(true, 3) && !ble_pair_auto_open_wanted(true, 0xFFFFu));   // any count above zero
    // what it opens is the ordinary window: 120.0 s, a number may be shown inside it, and it ends by itself
    ble_pair_window_t w;
    ble_pair_init(&w);
    CHECK(!ble_pair_is_open(&w, 100));
    if (ble_pair_auto_open_wanted(true, 0)) ble_pair_open(&w, 100);
    CHECK(ble_pair_is_open(&w, 100) && ble_pair_left_ms(&w, 100) == BLE_PAIR_WINDOW_MS && ble_numcmp_request(&w, 100) == BLE_NUMCMP_SHOW);
    CHECK(!ble_pair_is_open(&w, 100 + BLE_PAIR_WINDOW_MS));
    // with a bond the glue never calls ble_pair_open: the window stays closed and a number is refused
    ble_pair_init(&w);
    if (ble_pair_auto_open_wanted(true, 1)) ble_pair_open(&w, 100);
    CHECK(!ble_pair_is_open(&w, 100) && ble_numcmp_request(&w, 100) == BLE_NUMCMP_REFUSE);
}

// Review L3 (2026-11-10): a No at the prompt used to close the only window until the next replug. With phone mode on and no bond stored the window now stays open
// to its original end (the same 120.0 s: nothing is extended, nothing reopens), so the phone may try again. A stored bond keeps the old rule.
static void test_a_no_leaves_the_auto_opened_window_open(void)
{
    CHECK(ble_pair_stays_open_after_no(true, 0));       // phone mode on, no bond: the window stays open
    CHECK(!ble_pair_stays_open_after_no(true, 1));      // a bond exists (a second phone, opened by hand): a No closes it, as before
    CHECK(!ble_pair_stays_open_after_no(true, 2));
    CHECK(!ble_pair_stays_open_after_no(false, 0));     // phone mode off: nothing to keep
    CHECK(!ble_pair_stays_open_after_no(false, 5));
    CHECK(!ble_pair_stays_open_after_no(true, 0xFFFFu));
    // the same rule as the auto-open: one place decides who may pair without a tap on [pair]
    for (unsigned bonds = 0; bonds < 4; bonds++) {
        CHECK(ble_pair_stays_open_after_no(true, bonds) == ble_pair_auto_open_wanted(true, bonds));
        CHECK(ble_pair_stays_open_after_no(false, bonds) == ble_pair_auto_open_wanted(false, bonds));
    }
    // bounded: keeping the window open does not move its end. A No at 40 s leaves 80 s; at 120.0 s it is over and a number is refused again.
    ble_pair_window_t w;
    ble_pair_init(&w);
    ble_pair_open(&w, 1000);
    CHECK(ble_numcmp_verdict(&w, 41000, 0) == BLE_PAIR_REJECT);                      // the No itself
    CHECK(ble_pair_stays_open_after_no(true, 0));                                    // (glue: no ble_pair_close)
    CHECK(ble_pair_is_open(&w, 41000) && ble_pair_left_ms(&w, 41000) == BLE_PAIR_WINDOW_MS - 40000);
    CHECK(ble_numcmp_request(&w, 41001) == BLE_NUMCMP_SHOW);                         // a second try inside the window gets its number
    CHECK(ble_numcmp_request(&w, 1000 + BLE_PAIR_WINDOW_MS) == BLE_NUMCMP_REFUSE);   // and the original 120.0 s still ends it
}

// Item 4a (2026-11-10): the auto-open is not a one-shot boot event. At each connect with phone mode on, no bond stored and the window closed (never opened, expired,
// closed by a touch) it opens again; with the window already open it is left alone (a connect does not extend it); with a bond stored it never does.
static void test_the_window_is_rearmed_at_a_connect(void)
{
    ble_pair_window_t w;
    ble_pair_init(&w);
    CHECK(ble_pair_rearm_wanted(&w, 1000, true, 0));                                   // never opened
    ble_pair_open(&w, 1000);
    CHECK(!ble_pair_rearm_wanted(&w, 1000 + BLE_PAIR_WINDOW_MS - 1, true, 0));         // open: left alone, not extended
    CHECK(ble_pair_rearm_wanted(&w, 1000 + BLE_PAIR_WINDOW_MS, true, 0));              // expired: opens again
    ble_pair_close(&w);
    CHECK(ble_pair_rearm_wanted(&w, 5000, true, 0));                                   // closed by hand (a touch): opens again at the next connect
    CHECK(!ble_pair_rearm_wanted(&w, 5000, true, 1) && !ble_pair_rearm_wanted(&w, 5000, true, 2));   // a bond stored: never
    CHECK(!ble_pair_rearm_wanted(&w, 5000, false, 0));                                 // phone mode off: never
    CHECK(!ble_pair_rearm_wanted(NULL, 5000, true, 1) && ble_pair_rearm_wanted(NULL, 5000, true, 0));   // no window object reads as closed
    // what it opens is the ordinary 120.0 s window, and the per-link hold cap still applies inside it
    ble_t b;
    ble_init(&b);
    ble_post(&b, BLE_EV_START, 0);
    ble_post(&b, BLE_EV_LINK_UP, 200000);
    if (ble_pair_rearm_wanted(&w, 200000, true, 0)) ble_pair_open(&w, 200000);
    ble_enc_hold_update(&b, &w, 200000 + BLE_ENC_HOLD_MAX_MS - 1, false);
    CHECK(b.prompting);
    ble_enc_hold_update(&b, &w, 200000 + BLE_ENC_HOLD_MAX_MS, false);
    CHECK(!b.prompting && ble_poll(&b, 200000 + BLE_ENC_HOLD_MAX_MS) == BLE_EV_ENC_TIMEOUT);
}

// Item 4a: advertising goes on while the pairing window is open (the 30 s ADV timeout would end it long before the 120 s window), and the timeout is due
// at once when the window closes.
static void test_advertising_goes_on_while_the_window_is_open(void)
{
    ble_t b;
    ble_pair_window_t w;
    ble_init(&b);
    ble_pair_init(&w);
    ble_post(&b, BLE_EV_START, 0);
    ble_pair_open(&w, 0);
    ble_adv_hold_update(&b, &w, 1000);
    CHECK(b.adv_hold && ble_poll(&b, BLE_ADV_TIMEOUT_MS) == BLE_EV_NONE);              // 30 s: still on the air
    ble_adv_hold_update(&b, &w, BLE_PAIR_WINDOW_MS - 1);
    CHECK(b.adv_hold && ble_poll(&b, BLE_PAIR_WINDOW_MS - 1) == BLE_EV_NONE);
    ble_adv_hold_update(&b, &w, BLE_PAIR_WINDOW_MS);                                   // the window ends: the timeout is due
    CHECK(!b.adv_hold && ble_poll(&b, BLE_PAIR_WINDOW_MS) == BLE_EV_ADV_TIMEOUT);
    // closed by hand: due at once
    ble_init(&b);
    ble_post(&b, BLE_EV_START, 0);
    ble_pair_open(&w, 0);
    ble_adv_hold_update(&b, &w, 40000);
    CHECK(ble_poll(&b, 40000) == BLE_EV_NONE);
    ble_pair_close(&w);
    ble_adv_hold_update(&b, &w, 41000);
    CHECK(ble_poll(&b, 41000) == BLE_EV_ADV_TIMEOUT);
    // no window: the old 30 s rule exactly
    ble_init(&b);
    ble_pair_init(&w);
    ble_post(&b, BLE_EV_START, 0);
    ble_adv_hold_update(&b, &w, BLE_ADV_TIMEOUT_MS - 1);
    CHECK(ble_poll(&b, BLE_ADV_TIMEOUT_MS - 1) == BLE_EV_NONE && ble_poll(&b, BLE_ADV_TIMEOUT_MS) == BLE_EV_ADV_TIMEOUT);
    // the hold is for ADVERTISING only, and a change of state clears it; NULL is ignored
    ble_init(&b);
    ble_pair_open(&w, 0);
    ble_adv_hold_update(&b, &w, 10);
    CHECK(!b.adv_hold);                                                                // OFF
    ble_post(&b, BLE_EV_START, 0);
    ble_adv_hold_update(&b, &w, 10);
    CHECK(b.adv_hold);
    ble_post(&b, BLE_EV_LINK_UP, 20);
    CHECK(!b.adv_hold);                                                                // SECURING: no advertising hold
    ble_adv_hold_update(&b, &w, 30);
    CHECK(!b.adv_hold);
    ble_adv_hold_update(NULL, &w, 30);
    ble_adv_hold_update(&b, NULL, 30);
    CHECK(!b.adv_hold);
}

// Item 4d: whether a connecting peer may hold a bond. The stack resolves a bonded phone's rotating address through the stored identity key and the lookup by
// identity address finds the bond (found = true). When it does not (found = false) and the peer shows a resolvable private address (random type, top two bits
// 01) while a bond is stored, the dial asks anyway: a bonded phone whose address the stack could not resolve then encrypts with its stored key; a stranger gets
// a request that the closed window refuses at the number. No bond stored: nothing to match, no request.
static void test_a_peer_that_may_hold_a_bond(void)
{
    const uint8_t rpa[6] = {1, 2, 3, 4, 5, 0x6A};         // little endian: the last byte is the top byte; 0x6A = 01...... : resolvable private
    const uint8_t stat[6] = {1, 2, 3, 4, 5, 0xC1};        // 11......: static random
    const uint8_t nrpa[6] = {1, 2, 3, 4, 5, 0x3F};        // 00......: non-resolvable private
    CHECK(ble_peer_may_hold_bond(true, 1, 1, stat));      // found: yes, whatever it looks like
    CHECK(ble_peer_may_hold_bond(true, 0, 0, NULL));
    CHECK(ble_peer_may_hold_bond(false, 1, 1, rpa));      // not found, RPA, a bond stored: possibly
    CHECK(ble_peer_may_hold_bond(false, 2, 1, rpa));
    CHECK(!ble_peer_may_hold_bond(false, 0, 1, rpa));     // no bond stored
    CHECK(!ble_peer_may_hold_bond(false, 1, 0, rpa));     // public address type: an address is an address, no resolving
    CHECK(!ble_peer_may_hold_bond(false, 1, 1, stat) && !ble_peer_may_hold_bond(false, 1, 1, nrpa));
    CHECK(!ble_peer_may_hold_bond(false, 1, 1, NULL));
    CHECK(!ble_peer_may_hold_bond(false, 1, 2, rpa) && !ble_peer_may_hold_bond(false, 1, 3, rpa));   // the identity types are already identities
}

// Fix A: while the window is open and the link is SECURING, the 3 s encryption deadline waits (a person must answer a consent prompt or compare a number on
// the phone). Review M1 (2026-11-10): the wait is capped at BLE_ENC_HOLD_MAX_MS (30 s) from the connect, per link, unless a number is on the screen: a silent
// peer cannot hold the one link for the whole 120 s window.
static void test_the_encryption_deadline_waits_while_the_window_is_open(void)
{
    ble_t b;
    ble_pair_window_t w;
    ble_init(&b);
    ble_pair_init(&w);
    ble_post(&b, BLE_EV_START, 0);
    ble_pair_open(&w, 500);
    ble_post(&b, BLE_EV_LINK_UP, 1000);
    CHECK(b.state == BLE_ST_SECURING);
    CHECK(BLE_ENC_HOLD_MAX_MS == 30000u && BLE_ENC_HOLD_MAX_MS < BLE_PAIR_WINDOW_MS);
    // window open: the deadline does not fire at 3 s, nor at 15 s, nor 1 ms before the cap
    ble_enc_hold_update(&b, &w, 1000, false);
    CHECK(ble_poll(&b, 1000 + BLE_ENC_DEADLINE_MS - 1) == BLE_EV_NONE);
    ble_enc_hold_update(&b, &w, 1000 + BLE_ENC_DEADLINE_MS, false);
    CHECK(ble_poll(&b, 1000 + BLE_ENC_DEADLINE_MS) == BLE_EV_NONE);
    ble_enc_hold_update(&b, &w, 16000, false);
    CHECK(ble_poll(&b, 16000) == BLE_EV_NONE);
    ble_enc_hold_update(&b, &w, 1000 + BLE_ENC_HOLD_MAX_MS - 1, false);
    CHECK(ble_poll(&b, 1000 + BLE_ENC_HOLD_MAX_MS - 1) == BLE_EV_NONE);
    // the cap: 30.000 s after the connect the hold ends and the 3 s (long gone) are due at once, although the window has 90 s left
    ble_enc_hold_update(&b, &w, 1000 + BLE_ENC_HOLD_MAX_MS, false);
    CHECK(ble_pair_is_open(&w, 1000 + BLE_ENC_HOLD_MAX_MS) && !b.prompting);
    CHECK(ble_poll(&b, 1000 + BLE_ENC_HOLD_MAX_MS) == BLE_EV_ENC_TIMEOUT);
    // and it stays dropped: a later update does not bring the hold back
    ble_enc_hold_update(&b, &w, 1000 + BLE_ENC_HOLD_MAX_MS + 5000, false);
    CHECK(!b.prompting && ble_poll(&b, 1000 + BLE_ENC_HOLD_MAX_MS + 5000) == BLE_EV_ENC_TIMEOUT);
    // a number on the screen holds it past the cap (the number has its own 30 s bound, BLE_PROMPT_MAX_MS, outside this module)
    ble_init(&b);
    ble_post(&b, BLE_EV_START, 0);
    ble_post(&b, BLE_EV_LINK_UP, 1000);
    ble_enc_hold_update(&b, &w, 1000 + BLE_ENC_HOLD_MAX_MS - 2000, false);
    ble_enc_hold_update(&b, &w, 1000 + BLE_ENC_HOLD_MAX_MS + 10000, true);
    CHECK(b.prompting && ble_poll(&b, 1000 + BLE_ENC_HOLD_MAX_MS + 10000) == BLE_EV_NONE);
    // the number goes: the cap (already over) applies at once
    ble_enc_hold_update(&b, &w, 1000 + BLE_ENC_HOLD_MAX_MS + 10001, false);
    CHECK(!b.prompting && ble_poll(&b, 1000 + BLE_ENC_HOLD_MAX_MS + 10001) == BLE_EV_ENC_TIMEOUT);
    // the cap counts from THIS link: the next link of the same window starts its own 30 s
    ble_init(&b);
    ble_post(&b, BLE_EV_START, 0);
    ble_post(&b, BLE_EV_LINK_UP, 20000);
    ble_post(&b, BLE_EV_LINK_DOWN, 40000);
    ble_post(&b, BLE_EV_LINK_UP, 41000);
    ble_enc_hold_update(&b, &w, 41000 + BLE_ENC_HOLD_MAX_MS - 1, false);
    CHECK(b.prompting && ble_poll(&b, 41000 + BLE_ENC_HOLD_MAX_MS - 1) == BLE_EV_NONE);
    // a clock that stepped back from the connect holds nothing for ever: no hold from a negative age (the poll says nothing either, ble_poll)
    ble_enc_hold_update(&b, &w, 100, false);
    CHECK(ble_poll(&b, 100) == BLE_EV_NONE);
    // the window is the shorter bound when it opened long ago: it ends at 120.0 s, 20 s into this link, and the hold ends with it
    ble_init(&b);
    ble_pair_open(&w, 0);
    ble_post(&b, BLE_EV_START, 0);
    ble_post(&b, BLE_EV_LINK_UP, 100000);
    ble_enc_hold_update(&b, &w, BLE_PAIR_WINDOW_MS - 1, false);
    CHECK(b.prompting && ble_poll(&b, BLE_PAIR_WINDOW_MS - 1) == BLE_EV_NONE);
    ble_enc_hold_update(&b, &w, BLE_PAIR_WINDOW_MS, false);
    CHECK(!b.prompting && ble_poll(&b, BLE_PAIR_WINDOW_MS) == BLE_EV_ENC_TIMEOUT);
    ble_pair_open(&w, 500);
    ble_init(&b);
    ble_post(&b, BLE_EV_START, 0);
    ble_post(&b, BLE_EV_LINK_UP, 1000);
    // closed by hand (a No, Forget, leaving the screen): due at once as well
    ble_init(&b);
    ble_post(&b, BLE_EV_START, 0);
    ble_pair_open(&w, 2000);
    ble_post(&b, BLE_EV_LINK_UP, 2100);
    ble_enc_hold_update(&b, &w, 2200, false);
    CHECK(ble_poll(&b, 2100 + BLE_ENC_DEADLINE_MS + 5000) == BLE_EV_NONE);
    ble_pair_close(&w);
    ble_enc_hold_update(&b, &w, 9000, false);
    CHECK(ble_poll(&b, 9000) == BLE_EV_ENC_TIMEOUT);
    // closed from the start: the old rule, 3.000 s and not before (2.999 s)
    ble_init(&b);
    ble_pair_init(&w);
    ble_post(&b, BLE_EV_START, 0);
    ble_post(&b, BLE_EV_LINK_UP, 1000);
    ble_enc_hold_update(&b, &w, 1000 + BLE_ENC_DEADLINE_MS - 1, false);
    CHECK(ble_poll(&b, 1000 + BLE_ENC_DEADLINE_MS - 1) == BLE_EV_NONE);
    ble_enc_hold_update(&b, &w, 1000 + BLE_ENC_DEADLINE_MS, false);
    CHECK(ble_poll(&b, 1000 + BLE_ENC_DEADLINE_MS) == BLE_EV_ENC_TIMEOUT);
    // a number on show still holds it with the window closed (the earlier rule, kept), and drops the hold when the number goes
    ble_enc_hold_update(&b, &w, 1000 + BLE_ENC_DEADLINE_MS, true);
    CHECK(ble_poll(&b, 1000 + BLE_ENC_DEADLINE_MS) == BLE_EV_NONE);
    ble_enc_hold_update(&b, &w, 1000 + BLE_ENC_DEADLINE_MS + 1, false);
    CHECK(ble_poll(&b, 1000 + BLE_ENC_DEADLINE_MS + 1) == BLE_EV_ENC_TIMEOUT);
    // the hold is for SECURING only: an untrusted peer in CONNECTED keeps the 10 s idle cap with the window open, and ADVERTISING keeps its 30 s
    ble_init(&b);
    ble_pair_open(&w, 0);
    ble_post(&b, BLE_EV_START, 0);
    ble_enc_hold_update(&b, &w, 10, false);
    CHECK(!b.prompting && ble_poll(&b, BLE_ADV_TIMEOUT_MS) == BLE_EV_ADV_TIMEOUT);
    ble_post(&b, BLE_EV_LINK_UP, 100);
    ble_post(&b, BLE_EV_ENCRYPTED, 200);
    CHECK(b.state == BLE_ST_CONNECTED);
    ble_enc_hold_update(&b, &w, 300, true);
    CHECK(!b.prompting && ble_poll(&b, 200 + BLE_IDLE_CAP_MS) == BLE_EV_IDLE_TIMEOUT);
    // a new link starts without a hold, and the next update sets it again
    ble_init(&b);
    ble_post(&b, BLE_EV_START, 0);
    ble_post(&b, BLE_EV_LINK_UP, 10);
    ble_enc_hold_update(&b, &w, 20, false);
    CHECK(b.prompting);
    ble_post(&b, BLE_EV_LINK_DOWN, 30);
    CHECK(!b.prompting);
    ble_enc_hold_update(NULL, &w, 20, false);   // no crash
    ble_post(&b, BLE_EV_LINK_UP, 40);
    ble_enc_hold_update(&b, NULL, 50, false);   // no window: the number alone decides
    CHECK(!b.prompting);
}

// Fix B: the dial sends its Security Request (which makes Android raise a consent prompt) only while the window is open or for a peer that is already bonded.
static void test_the_security_request_is_gated(void)
{
    ble_pair_window_t w;
    ble_pair_init(&w);
    CHECK(!ble_security_request_wanted(&w, 1000, false));    // closed, stranger: no request (the existing 3 s / idle rules drop the link)
    CHECK(ble_security_request_wanted(&w, 1000, true));      // closed, bonded peer: its stored key is asked for
    ble_pair_open(&w, 2000);
    CHECK(ble_security_request_wanted(&w, 2000, false));     // open, stranger: the user is pairing
    CHECK(ble_security_request_wanted(&w, 2000 + BLE_PAIR_WINDOW_MS - 1, false));
    CHECK(ble_security_request_wanted(&w, 2000, true));
    CHECK(!ble_security_request_wanted(&w, 2000 + BLE_PAIR_WINDOW_MS, false));   // 120.0 s: over
    CHECK(ble_security_request_wanted(&w, 2000 + BLE_PAIR_WINDOW_MS, true));
    CHECK(!ble_security_request_wanted(&w, 1999, false));    // a clock that stepped back from the open: closed
    ble_pair_close(&w);
    CHECK(!ble_security_request_wanted(&w, 2500, false) && ble_security_request_wanted(&w, 2500, true));
    CHECK(!ble_security_request_wanted(NULL, 1000, false) && ble_security_request_wanted(NULL, 1000, true));
}

int main(int argc, char **argv)
{
    assert(argc == 2 && "usage: test_ble_state <vectors/ble_status.txt>");
    test_advertising_against_the_vectors(argv[1]);
    test_table();
    test_constants_match_the_vectors(argv[1]);
    test_deadlines();
    test_churn_is_counted_per_link_and_proven_by_tls();
    test_a_peer_that_is_not_trusted_is_dropped_when_idle();
    test_the_refused_wait_escalates_only_for_a_trusted_peer();
    test_the_pairing_window();
    test_advertising_restarts_by_itself_and_on_a_wake();
    test_post_keeps_the_clock_of_a_state_that_did_not_change();
    test_refusal_run();
    test_accept_policy();
    test_gatt_values_against_the_vectors(argv[1]);
    test_the_numeric_comparison_offer();
    test_the_encryption_deadline_waits_for_the_number();
    test_the_window_time_left();
    test_the_number_is_shown_for_a_bounded_time();
    test_a_weak_bond_is_unwanted();
    test_the_pair_window_opens_by_itself_only_when_unbonded();
    test_the_encryption_deadline_waits_while_the_window_is_open();
    test_a_no_leaves_the_auto_opened_window_open();
    test_the_window_is_rearmed_at_a_connect();
    test_advertising_goes_on_while_the_window_is_open();
    test_a_peer_that_may_hold_a_bond();
    test_the_security_request_is_gated();
    printf("test_ble_state: %u checks PASS\n", checks);
    return 0;
}
